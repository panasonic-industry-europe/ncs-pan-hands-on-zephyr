## drivers/sensor/sngcja5/Kconfig
```kconfig
# SN-GCJA5 Laser Particle Sensor configuration options

# Copyright (c) 20227 Panasonic Industrial Devices Europe GmbH
# SPDX-License-Identifier: Apache-2.0

menuconfig SNGCJA5
	bool "SN-GCJA5 laser particle sensor"
	depends on I2C
	help
	  Enable driver for SN-GCJA5 laser particle sensor.
```

## dts/bindings/sensor/panasonic,sngcja5.yaml
```yaml
# Copyright (c) 2022, Panasonic Industrial Devices Europe GmbH
# SPDX-License-Identifier: Apache-2.0

description: Panasonic SN-GCJA5 Laser Particle Sensor

compatible: "panasonic,sngcja5"

include: i2c-device.yaml
```
